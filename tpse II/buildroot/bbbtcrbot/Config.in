## tpse II/buildroot/bbbtcrbot/Config.in
```kconfig
config BR2_PACKAGE_BBBTCRBOT
	bool "bbbtcrbot"
	help
		Um seguidor de linha que tira os obstáculos do caminho
```

## tpse II/buildroot/hello/Config.in
```kconfig
config BR2_PACKAGE_HELLO
	bool "hello"
	help
		Linux Kernel Hello World With Parameters
```

## tpse II/buildroot/hello_param/Config.in
```kconfig
config BR2_PACKAGE_HELLO_PARAM
	bool "hello_param"
	help
		Linux Kernel Hello World With Parameters
```

## tpse II/buildroot/i2c_ads1115/Config.in
```kconfig
config BR2_PACKAGE_I2C_ADS1115
	bool "i2c_ads1115"
	help
		A friendly program that use ads1115 adc with i2c
```

## tpse II/buildroot/leds/Config.in
```kconfig
config BR2_PACKAGE_LEDS
	bool "leds"
	help
		A friendly program that blink the leds of bbb
```

## tpse II/buildroot/ledsaleatory/Config.in
```kconfig
config BR2_PACKAGE_LEDSALEATORY
	bool "ledsaleatory"
	help
		A friendly program that blink the leds aleatory of bbb
```

## tpse II/drivers/driver_hello/Config.in
```kconfig
config BR2_PACKAGE_KERNEL_MODULE_HELLO
	bool "hello"
	depends on BR2_LINUX_KERNEL
	help
		Linux Kernel Hello World
```

## tpse II/drivers/driver_hello_param/Config.in
```kconfig
config BR2_PACKAGE_KERNEL_MODULE_HELLO_PARAM
	bool "hello_param"
	depends on BR2_LINUX_KERNEL
	help
		Linux Kernel Hello World With Parameters
```
